/******************************************************************************
 * @file    OLED_MouadhJeridi.c
 * @brief   High level SSD1306 OLED helpers (init, mirroring, text, scrolling).
 *
 * @author  Mouadh Jeridi <jeridimouadh@gmail.com>
 * @version 2.3.3
 * @date    2026-09-25
 ******************************************************************************/
#include "OLED_MouadhJeridi.h"

uint8_t current_mirror_horizental_pos;
uint8_t current_mirror_vertical_pos;

const uint8_t fire_bitmap[] = {
0x00, 0x00, 0x00, 0x00, 0x00, 0x00, 0x00, 0x00, 0x00, 0x00, 0x00, 0x00, 0x80, 0x00, 0x00, 0x00, 
0x00, 0x00, 0x00, 0x07, 0x80, 0x00, 0x00, 0x00, 0x00, 0x00, 0x00, 0x0f, 0x80, 0x00, 0x00, 0x00, 
0x00, 0x00, 0x00, 0x1f, 0x80, 0x00, 0x00, 0x00, 0x00, 0x00, 0x00, 0x3f, 0x80, 0x00, 0x00, 0x00, 
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0x00, 0x00, 0x10, 0x01, 0xc0, 0x00, 0x00, 0x00, 0x00, 0x00, 0x00, 0x00, 0x00, 0x00, 0x00, 0x00
};

/** @brief Initializes the SSD1306 controller and the mirroring state. */
void OLED_MJ_Init(void)
{
    ssd1306_Init();
    current_mirror_horizental_pos = MIRROR_HORIZENTAL_NORMAL_CMD;
    current_mirror_vertical_pos   = MIRROR_VERTICAL_NORMAL_CMD;
}

/** @brief Toggles the horizontal segment remapping command (A0/A1). */
void OLED_MJ_mirror_horizental(void)
{
    current_mirror_horizental_pos = current_mirror_horizental_pos == MIRROR_HORIZENTAL_NORMAL_CMD ?
                                    MIRROR_HORIZENTAL_FLIPPED_CMD : MIRROR_HORIZENTAL_NORMAL_CMD;
    ssd1306_WriteCommand(current_mirror_horizental_pos);
}

/** @brief Toggles the vertical COM scan direction command (C0/C8). */
void OLED_MJ_mirror_vertical(void)
{
    current_mirror_vertical_pos = current_mirror_vertical_pos == MIRROR_VERTICAL_NORMAL_CMD ?
                                    MIRROR_VERTICAL_FLIPPED_CMD : MIRROR_VERTICAL_NORMAL_CMD;
    ssd1306_WriteCommand(current_mirror_vertical_pos);
}

/** @brief Returns the rendered width in pixels of a string for a given font. */
uint8_t OLED_MJ_string_width(char* str, SSD1306_Font_t Font)
{
  uint8_t len = 0;
  if(str)
  {
    len = strlen(str);
  }
    uint8_t string_width = 0;
    for (uint8_t i = 0; i < len; i++)
    {
       string_width += Font.char_width ? Font.char_width[str[i]-32] : Font.width;
    }
    return string_width;
}

/** @brief Writes text at an absolute position in the frame buffer. */
void OLED_MJ_write(char* str, int16_t x, uint8_t y, SSD1306_Font_t Font, SSD1306_COLOR color)
{
    ssd1306_SetCursor(x, y);
    ssd1306_WriteString(str , Font, color);
}

/** @brief Writes horizontally centered text in the frame buffer. */
void OLED_MJ_write_in_middle(char* str, uint8_t y, SSD1306_Font_t Font, SSD1306_COLOR color)
{
    ssd1306_SetCursor((OLED_MJ_WIDTH - OLED_MJ_string_width(str, Font))/2, y);
    ssd1306_WriteString(str , Font, color);
}

/** @brief Draws a left-to-right marquee step of a string. */
void OLED_MJ_sweep_left_to_right(char* str, uint8_t y, uint8_t step, SSD1306_Font_t Font, SSD1306_COLOR color)
{
    static uint8_t oled_y;
    static int16_t oled_x;
    static int initialized_line = 0;
    uint8_t string_width = OLED_MJ_string_width(str, Font);
    if (initialized_line == 0)
    {
        initialized_line = 1;
        oled_y = y;
        oled_x = -string_width;
    }
    if(y != oled_y)
    {
        oled_x = -string_width;
    }
    oled_x += oled_x < OLED_MJ_WIDTH ? step : -oled_x-string_width;
    ssd1306_SetCursor(oled_x, oled_y);
    ssd1306_WriteString(str , Font, color);
}

/** @brief Draws a right-to-left marquee step of a string. */
void OLED_MJ_sweep_right_to_left(char* str, uint8_t y, uint8_t step, SSD1306_Font_t Font, SSD1306_COLOR color)
{
    static uint8_t oled_y;
    static int16_t oled_x;
    static int initialized_line = 0;
    if (initialized_line == 0)
    {
        initialized_line = 1;
        oled_y = y;
        oled_x = OLED_MJ_WIDTH;
    }
    if(y != oled_y)
    {
        oled_x = OLED_MJ_WIDTH;
    }
    uint8_t string_width = OLED_MJ_string_width(str, Font);
    oled_x -= oled_x <= -string_width ? -string_width-OLED_MJ_WIDTH : step;
    ssd1306_SetCursor(oled_x, oled_y);
    ssd1306_WriteString(str , Font, color);
}

